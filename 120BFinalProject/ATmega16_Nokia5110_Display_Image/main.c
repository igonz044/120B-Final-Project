#include <avr/io.h>
#include <avr/interrupt.h>
# define F_CPU 1000000UL
#include "scheduler.h"
#include "bit.h"
#include "timer.h"
#include <stdio.h>
#include <stdlib.h>
#include "io.c"
#include "io.h"
//#include "keypad.h"
#include "nokia5110.h"
#include "nokia5110.c"

//Defining Buttons
#define A0 (~PINA & 0x04) //reset
#define A3 (~PINA & 0x08) //left button
#define A2 (~PINA & 0x10) //middle button
#define A1 (~PINA & 0x20) //right button

int height = 84;
int width = 48;
int speed = 5;
int gametick = 0;
int barStart = 9;
int barStop = 3;
int score = 0;
int miss = 0;
int isRunning = 1;
int x = 20;
int y = 20;
int light_val = 0;
int found = 0;

///////////////////////////////////JOYSTICK////////////////////////////////////////////
void InitADC() {
	ADMUX=(1<<REFS0);                   //setting the reference of ADC such THAT Areff=Avcc     			 
	ADCSRA=(1<<ADEN)|(1<<ADPS2)|(1<<ADPS1)|(1<<ADPS0); 	 
}
//used something new datatype her to check if it works or not, unsigned integer short can aolso be written as unint16_t 

uint16_t ReadADC(uint8_t ch)
{	InitADC();
	ch=ch&0b00000111; //im using this channel to be a extra safety net for the correct reading 
	ADMUX|=ch; // it will read from the first three channels
	//conversion steps
	ADCSRA|=(1<<ADSC);
	while(!(ADCSRA & (1<<ADIF)));
	ADCSRA|=(1<<ADIF); // got from one of the labs
	return(ADC);
}
//code for reading which direction is the joystick pointing to0 
uint16_t find_direction_from_xy(uint16_t x, uint16_t y)
{
	//1-> up, 2-> right, 3-> down 4-> left
	if(x>255 && x<765 && y>615) // we know 1024 is the max value, these values are exact half of the max values which i had using the joystick
	return(1); // direction is up

	else if(x>615 && y>255 && y<765)
	return(2); //direction is right 

	else if(x>255 && x<765 && y<255)
	return(3); //direction is down 

	else if(x<405 && y>255 && y<765)
	return(4); // direction is left

	else
	return(0); //default state
} 
///////////////////////////////////JOYSTICK////////////////////////////////////////////
// int grid[84][48];
const int setbabyGrid[84][48] = {
	{0,0,0,0,0,0,0,0,0,0,0,0,0,0,0,0,0,0,0,0,0,0,0,0,0,0,0,0,0,0,0,0,0,0,0,0,0,0,0,0,0,0,0,0,0,0,0,0},
	{0,0,0,0,0,0,0,0,0,0,0,0,0,0,0,0,0,0,0,0,0,0,0,0,0,0,0,0,0,0,0,0,0,0,0,0,0,0,0,0,0,0,0,0,0,0,0,0},
	{0,0,0,0,0,1,1,0,0,0,0,0,0,0,1,1,0,0,1,1,1,1,1,0,0,0,1,1,0,1,1,0,0,0,0,0,1,1,0,0,0,0,0,0,0,0,0,0},
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	{0,0,0,0,0,0,0,0,0,0,0,0,0,0,0,0,0,0,0,0,0,0,0,0,0,0,0,0,0,0,0,0,0,0,0,0,0,0,0,0,0,0,0,0,0,0,0,0}
	};
const int setstudentGrid[84][48] = {
	{0,0,0,0,0,0,0,0,0,0,0,0,0,0,0,0,0,0,0,0,0,0,0,0,0,0,0,0,0,0,0,0,0,0,0,0,0,0,0,0,0,0,0,0,0,0,0},
	{0,0,0,0,0,0,0,0,0,0,0,0,0,0,0,0,0,0,0,0,0,0,0,0,0,0,0,0,0,0,0,0,0,0,0,0,0,0,0,0,0,0,0,0,0,0,0},
	{0,0,0,0,1,1,0,0,0,0,0,0,0,1,1,0,0,1,1,1,1,1,0,0,0,1,1,0,1,1,0,0,0,0,0,1,1,0,0,0,0,0,0,0,0,0,0},
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	{0,0,0,0,0,0,0,0,0,0,0,0,0,0,0,0,0,0,0,0,0,0,0,0,0,0,0,0,0,0,0,0,0,0,0,0,0,0,0,0,0,0,0,0,0,0,0}
	};
const int setJeffGrid[84][48] = {
	{0,0,0,0,0,0,0,0,0,0,0,0,0,0,0,0,0,0,0,0,0,0,0,0,0,0,0,0,0,0,0,0,0,0,0,0,0,0,0,0,0,0,0,0,0,0,0,0},
	{0,0,0,0,0,0,0,0,0,0,0,0,0,0,0,0,0,0,0,0,0,0,0,0,0,0,0,0,0,0,0,0,0,0,0,0,0,0,0,0,0,0,0,0,0,0,0,0},
	{0,0,0,0,0,1,1,0,0,0,0,0,0,0,1,1,0,0,1,1,1,1,1,0,0,0,1,1,0,1,1,0,0,0,0,0,1,1,0,0,0,0,0,0,0,0,0,0},
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	{0,0,0,0,0,0,0,0,0,0,0,0,0,0,0,0,0,0,0,0,0,0,0,0,0,0,0,0,0,0,0,0,0,0,0,0,0,0,0,0,0,0,0,0,0,0,0,0}
	};
// const int setDefaultGrid[84][48] = {
int grid[84][48] = {
	{0,0,0,0,0,0,0,0,0,0,0,0,0,0,0,1,1,0,0,0,0,0,0,0,0,0,0,0,0,0,0,1,1,0,0,0,0,0,0,0,0,0,0,0,0,0,0,0},
	{0,0,0,0,0,0,0,0,0,0,0,0,0,0,0,1,1,0,0,0,0,0,0,0,0,0,0,0,0,0,0,1,1,0,0,0,0,0,0,0,0,0,0,0,0,0,0,0},
	{0,0,0,0,0,0,0,0,0,0,0,0,0,0,0,1,1,0,0,0,0,0,0,0,0,0,0,0,0,0,0,1,1,0,0,0,0,0,0,0,0,0,0,0,0,0,0,0},
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	{0,0,0,0,0,0,0,0,0,0,0,0,0,0,0,1,1,0,0,0,0,0,0,0,0,0,0,0,0,0,0,1,1,0,0,0,0,0,0,0,0,0,0,0,0,0,0,0}
	};

void setgrid(const int a[][48]){
	for(int i = 0; i < height; i++){
		for(int j = 0; j < width; j++){
			grid[i][j] = a[i][j];
		}
	}
}
struct Piece {
	int x;
	int y;
};
struct Piece A = {
	.x=0,
	.y=0
};
struct Piece B = {
	.x=16,
	.y=0
};
struct Piece C = {
	.x=32,
	.y=0
};

struct Piece generatePiece() {
	switch(rand() % 3){
		case 0:
		return A;
		break;
		case 1:
		return B;
		break;
		case 2:
		return C;
		break;
		default:
		return A;
		break;
	}
}
const int numofPieces = 90;
struct Piece pieces[90] = {{.x=0,.y=100}};
int piecesCursor = 0;

void resetgrid(){
	speed = 5;
	for(int i = height - 9; i < height; i++){
		for(int j = 0; j < width; j++){
			grid[i][j] = 0;
		}
	}
}
void babyMode(){
	speed = 5;
	barStart = 9;
	// barStop = 3;
	for(int i = 0; i < width; i++){
		grid[height - barStart][i] = 1;
		// grid[height - barStop][i] = 1;
	}
}
void studentMode(){
	speed = 3;
	barStart = 8;
	// barStop = 4;
	for(int i = 0; i < width; i++){
		grid[height - barStart][i] = 1;
		// grid[height - barStop][i] = 1;
	}
}
void JeffMode(){
	speed = 1;
	barStart = 7;
	// barStop = 5;
	for(int i = 0; i < width; i++){
		grid[height - barStart][i] = 1;
		// grid[height - barStop][i] = 1;
	}
}

int isPieceHere(int y, int x){
	for(int i = 0; i < numofPieces; i++){
		if(pieces[i].x <= x - 2 && pieces[i].x > x - 14 && pieces[i].y >= y - 2 && pieces[i].y <= y + 2){
			return 1;
		}
	}
	return 0;
}

void ButtonA(){
	found = 0;
	for(int i = 0; i < numofPieces; i++){
		if(pieces[i].y < height && pieces[i].y >= height - barStart && pieces[i].x == 0){
			pieces[i].y = height + 3;
			found = 1;
		}
	}
	if(found) score++;
}
void ButtonB(){
	found = 0;
	for(int i = 0; i < numofPieces; i++){
		if(pieces[i].y < height && pieces[i].y >= height - barStart && pieces[i].x == 16){
			pieces[i].y = height + 3;
			found = 1;
		}
	}
	if(found) score++;
}
void ButtonC(){
	found = 0;
	for(int i = 0; i < numofPieces; i++){
		if(pieces[i].y < height && pieces[i].y >= height - barStart && pieces[i].x == 32){
			pieces[i].y = height + 3;
			found = 1;
		}
	}
	if(found) score++;
}

void showGridOnNokia(){
	nokia_lcd_clear();
	for(int i = 0; i < height; i++){
		// for(int j = width - 1; j >= 0; j--){
		for(int j = 0; j < width; j++){
			if(isPieceHere(i,j) || grid[i][j] == 1){
				// if(grid[i][j] == 1){
				nokia_lcd_set_pixel(i, j, 1);
				// tempgrid[i][width - 1 - j];
				}else{
				nokia_lcd_set_pixel(i, j, 0);
			}
		}
	}
	nokia_lcd_render();
}

// unsigned char PINAtmp;

//SM1 Declarations
enum Obstacle_State {init_OS, play_OS, end_OS} OS_State;

//SM2 Declarations
enum Player_State {init_PS, wait_PS, pressUp_PS, pressDown_PS, release_PS, pause_PS} PS_State;

//SM3 Declarations
enum Display_State {init_DS, check_DS, display_DS, winner_DS, loser_DS, pause_DS} DS_State;

int ObstacleTick(int B);
int PlayerTick(int C);
int DisplayTick(int D);


void restartGame(){
	for(int i = 0; i < numofPieces; i++){
		pieces[i].x = 0;
		pieces[i].y = 100;
	}
	PS_State = init_PS;
	OS_State = init_OS;
	DS_State = init_DS;
	score = 0;
	miss = 0;
	studentMode();
	// score = 5;
}
int main()
{
	// Set Data Direction Registers
	// Buttons PORTA[0-7], set AVR PORTA to pull down logic
	DDRA = 0x00; PORTA = 0xFF; //BUTTONS
	// DDRB = 0xFF; PORTB = 0x00;
	DDRC = 0xF0; PORTC = 0x0F; // PC7..4 outputs init 0s, PC3..0 inputs init 1s
	DDRD = 0xFF; PORTD = 0x00; //LEDs
	// Period for the tasks

	//Declare an array of tasks
	static task task1, task2, task3;
	task *tasks[] = { &task1, &task2,&task3};
	const unsigned short numTasks = sizeof(tasks)/sizeof(task*);
	//There was only one task to do so the size = 1;

	task1.state = init_OS;
	task1.period = 1; //Task Period.
	task1.elapsedTime =task1.period;
	task1.TickFct = &ObstacleTick;
	
	task2.state = init_PS;
	task2.period = 1; //Task Period.
	task2.elapsedTime =task2.period;
	task2.TickFct = &PlayerTick;
	
	task3.state = init_DS;
	task3.period = 1; //Task Period.
	task3.elapsedTime =task3.period;
	task3.TickFct = &DisplayTick;

	// Set the timer and turn it on
	TimerSet(10);
	TimerOn();
	nokia_lcd_init();
	// nokia_lcd_power(1);
	// nokia_lcd_set_cursor(24,40);

	unsigned short i; // Scheduler for-loop iterator
	while(1) {
		// PINAtmp = ~PINA & 0x1C;
		for ( i = 0; i < numTasks; i++ ) {
			if ( tasks[i]->elapsedTime >= tasks[i]->period ) {
				tasks[i]->state = tasks[i]->TickFct(tasks[i]->state);
				tasks[i]->elapsedTime = 0;
			}
			tasks[i]->elapsedTime += 1;
		}
		while(!TimerFlag);
		TimerFlag = 0;
	}
	return 0;
}

int ObstacleTick(int OS_State)
{
	switch(OS_State)
	{
		case init_OS:
		// WELCOME SCREEN
		// setgrid(setstudentGrid);
		// // if (find_direction_from_xy(x,y)== 1){ //down - start
		// // 	setgrid(setDefaultGrid);
		// // 	OS_State = play_OS;
		// // }
		// // setWelcomeGrid();
		// // choose difficulty
		// // ifjoystick set 1,2,3 then move to play_OS
		// if (find_direction_from_xy(x,y)== 2){ //right - easy
		// 	setgrid(setbabyGrid);
		// 	studentMode();
		// 	if (find_direction_from_xy(x,y)== 1){ //down - start
		// 		setgrid(setDefaultGrid);
		// 		OS_State = play_OS;
		// 	}
		// }

		// if (find_direction_from_xy(x,y)== 4){ //left - easy
		// 	setgrid(setJeffGrid);
		// 	JeffMode();
		// 	if (find_direction_from_xy(x,y)== 1){ //down - start
		// 		setgrid(setDefaultGrid);
		// 		OS_State = play_OS;
		// 	}
		// }
		// setgrid(setDefaultGrid);
		studentMode();
		OS_State = play_OS;
		/// babyMode();		
		break;

		case play_OS:
		// ACTUAL GAME
		break;
		case end_OS:
		// END SCREEN
		break;
		default:
		break;
	}

	switch(OS_State)
	{
		case init_OS:
		break;

		case play_OS:
			if(gametick++ % speed == 0){
				pieces[piecesCursor] = generatePiece();
				if(piecesCursor >= numofPieces - 1) piecesCursor = 0;
				else piecesCursor++;
			}

			found = 0;
			for(int i = 0; i < numofPieces; i++){
				if(pieces[i].y < height && pieces[i].y >= height - barStart && (pieces[i].x == 32 || pieces[i].x == 16 || pieces[i].x == 0)){
					// pieces[i].y = height + 3;
					pieces[i].y = height - 15;
					pieces[i].x = height + 7;
					found = 1;
				}
			}
			if(found){
				score--;
				miss++;
			}

			if(miss >= 3){restartGame();}
			if(score >= 10){restartGame();}

			light_val = 0x00;
			switch(score){
				case 9 ... 100: light_val += 0x40;
				case 7 ... 8: light_val += 0x20;
				case 5 ... 6: light_val += 0x10;
				case 3 ... 4: light_val += 0x08;
				case 1 ... 2: light_val += 0x04;
				break;
				default:
				break;
			}
			PORTD = light_val;

			for(int i = 0; i < numofPieces; i++){
				if(pieces[i].y < height){
					pieces[i].y+=6;
				}
			}
		break;
		
		case end_OS:
		break;
		
		default:
		break;
	}

	return OS_State;
}

//enum Player_State {init_PS, wait_PS, pressUp_PS, pressDown_PS, release_PS, pause_PS} PS_State;
int PlayerTick(int PS_State)
{
	// unsigned char UpDown = PINAtmp & 0x18;
	switch(PS_State)
	{
		case init_PS:
		break;
		case wait_PS:
		if(((~PINA) & 0x3C) == 0){PS_State = init_PS;}
		break;

		default:
		break;
	}

	switch(PS_State)
	{
		case init_PS:
			x = ReadADC(0);
			y = ReadADC(1);
			if(find_direction_from_xy(x,y)){ restartGame();} //reset
			if(A1){ ButtonA();} //left
			if(A2){ ButtonB();} //middle
			if(A3){ ButtonC();} //right

		break;
		case wait_PS:
		break;
		default:
		break;
	}
	return PS_State;
}



int DisplayTick(int DS_State)
{
	switch(DS_State)
	{
		case init_DS:
		showGridOnNokia();
		break;
		default:
		break;
	}

	switch(DS_State)
	{
		case init_DS:
		break;
		default:
		break;
	}

	return DS_State;
}
